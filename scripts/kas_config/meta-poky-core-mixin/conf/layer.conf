## scripts/kas_config/meta-poky-core-mixin/conf/layer.conf
```bitbake
BBPATH =. "${LAYERDIR}:"

BBFILES += "${LAYERDIR}/recipes-*/*.bb \
            ${LAYERDIR}/recipes-*/*.bbappend"

BBFILE_COLLECTIONS += "meta-poky-core-mixin"
BBFILE_PATTERN_meta-poky-core-mixin = "^${LAYERDIR}/"
BBFILE_PRIORITY_meta-poky-core-mixin = "6"

BBFILES_DYNAMIC += "\
    foo-bar-layer:${LAYERDIR}/dynamic-layers/foo-bar-layer/*.bb \
    foo-bar-layer:${LAYERDIR}/dynamic-layers/foo-bar-layer/*.bbappend \
"
LAYERVERSION_meta-poky-core-mixin = "1"

LAYERSERIES_COMPAT_meta-poky-core-mixin = "dunfell gatesgarth hardknott honister kirkstone langdale mickledore nanbield scarthgap styhead walnascar"
```

## tests/testlayer/conf/layer.conf
```bitbake
BBFILE_COLLECTIONS += "testlayer"

BBFILE_PRIORITY_testlayer = "99"
LAYERDEPENDS_testlayer = "foo"
```

## tests/testlayer2/conf/layer.conf
```bitbake
BBFILE_COLLECTIONS += "meta-testlayer2"

BBFILE_PRIORITY_meta-testlayer2 = "99"
LAYERDEPENDS_meta-testlayer2 = "foo bar"
```
